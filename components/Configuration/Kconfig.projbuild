## sdkconfig.defaults.pcb
```kconfig
#
# CS PCB configuration
#
CONFIG_WIFI_MODE_SOFTAP=y
CONFIG_OPS_HBRIDGE_LMD18200=y
CONFIG_OPS_ENABLE_PIN=17
CONFIG_OPS_THERMAL_PIN=0
CONFIG_OPS_SIGNAL_PIN=5
CONFIG_OPS_ADC_CHANNEL_5=y
CONFIG_OPS_RAILCOM=y
CONFIG_OPS_RAILCOM_ENABLE_PIN=26
CONFIG_OPS_RAILCOM_BRAKE_PIN=25
CONFIG_OPS_RAILCOM_SHORT_PIN=27
CONFIG_OPS_RAILCOM_UART2=y
CONFIG_OPS_RAILCOM_UART_RX_PIN=36
CONFIG_PROG_HBRIDGE_L298=y
CONFIG_PROG_ENABLE_PIN=18
CONFIG_PROG_SIGNAL_PIN=19
CONFIG_PROG_ADC_CHANNEL_6=y
CONFIG_LCC_CAN_ENABLED=y
CONFIG_LCC_CAN_RX_PIN=35
CONFIG_LCC_CAN_TX_PIN=32
CONFIG_STATUS_LED=y
CONFIG_STATUS_LED_DATA_PIN=22
CONFIG_STATUS_LED_TYPE_APA106=y
CONFIG_GPIO_OUTPUTS=n
CONFIG_GPIO_SENSORS=n
CONFIG_GPIO_S88=n
CONFIG_DISPLAY_SCL=21
CONFIG_DISPLAY_SDA=23

#
# SDK configuration
#
CONFIG_ESPTOOLPY_FLASHSIZE_4MB=y
CONFIG_LOG_DEFAULT_LEVEL_WARN=y
CONFIG_HEAP_POISONING_LIGHT=y
CONFIG_PARTITION_TABLE_CUSTOM=y
CONFIG_PARTITION_TABLE_CUSTOM_FILENAME="ESP32CS-partitions.csv"
CONFIG_PARTITION_TABLE_FILENAME="ESP32CS-partitions.csv"
CONFIG_PARTITION_TABLE_TWO_OTA=n
CONFIG_PARTITION_TABLE_SINGLE_APP=n
CONFIG_COMPILER_STACK_CHECK_MODE_NORM=y
CONFIG_COMPILER_STACK_CHECK=y
CONFIG_COMPILER_OPTIMIZATION_LEVEL_RELEASE=y

#
# FreeRTOS configuration
#
CONFIG_FREERTOS_VTASKLIST_INCLUDE_COREID=y
CONFIG_FREERTOS_GENERATE_RUN_TIME_STATS=y
CONFIG_FREERTOS_USE_TRACE_FACILITY=y
CONFIG_FREERTOS_GENERATE_RUN_TIME_STATS=y
CONFIG_FREERTOS_HZ=1000

#
# LwIP configuration
#

CONFIG_LWIP_SO_RCVBUF=y
CONFIG_LWIP_LOCAL_HOSTNAME="esp32cs"
CONFIG_LWIP_IRAM_OPTIMIZATION=y
CONFIG_LWIP_MAX_SOCKETS=16
CONFIG_LWIP_ETHARP_TRUST_IP_MAC=y
CONFIG_LWIP_DHCP_RESTORE_LAST_IP=y
CONFIG_LWIP_MAX_LISTENING_TCP=10

#
# WiFi configuration
#
CONFIG_ESP32_WIFI_NVS_ENABLED=n
CONFIG_ESP32_WIFI_STATIC_RX_BUFFER_NUM=16
CONFIG_ESP32_WIFI_RX_BA_WIN=16

#
# Task stack configuration
#

CONFIG_ESP_MAIN_TASK_STACK_SIZE=9216
CONFIG_ESP_IPC_TASK_STACK_SIZE=2048
CONFIG_ESP_SYSTEM_EVENT_TASK_STACK_SIZE=2816

#
# Watchdog configuration
#
CONFIG_ESP_INT_WDT_TIMEOUT_MS=1800
CONFIG_ESP_TASK_WDT_CHECK_IDLE_TASK_CPU0=n

#
# FATFS configuration
#
CONFIG_FATFS_CODEPAGE_850=y
CONFIG_FATFS_LFN_HEAP=y
CONFIG_FATFS_LFN_STACK=y
CONFIG_FATFS_MAX_LFN=255

#
# Unity configuration
#
CONFIG_UNITY_ENABLE_IDF_TEST_RUNNER=n

#
# pthread configuration
#
CONFIG_PTHREAD_TASK_PRIO_DEFAULT=1
CONFIG_PTHREAD_TASK_STACK_SIZE_DEFAULT=2048

#
# SPIFFS configuration
#
CONFIG_SPIFFS_MAX_PARTITIONS=1
```
