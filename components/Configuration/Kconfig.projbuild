## components/Configuration/Kconfig.projbuild
```kconfig
menu "Advanced Configuration Options"

    config ESP32CS_FORCE_FACTORY_RESET
        bool "Clear *ALL* configuration settings on startup"
        default n
        help
            Enabling this option will force clear all persistent configuration
            settings upon startup. This generally should not be required to be
            used.

    config AUTO_CREATE_ROSTER_ENTRIES
        bool "Create a roster entry for new trains on first use"
        default y

    config ROSTER_PERSISTENCE_INTERVAL_SEC
        int "Number of seconds between automatic persistence of train roster"
        default 30

    config ALLOW_USAGE_OF_RESTRICTED_GPIO_PINS
        bool "Allow usage of restricted GPIO pins"
        help
            Enables usage of the following pins for sensors and outputs
            0 - Bootstrap / Firmware Flash Download
            1 - UART0 TX
            2 - Bootstrap / Firmware Flash Download
            3 - UART0 RX
            5 - Bootstrap
            6, 7, 8, 9, 10, 11 - flash pins
            12, 15 - Bootstrap / SD pins
        default n
        depends on GPIO_OUTPUTS || GPIO_SENSORS || GPIO_S88

endmenu
```
