## components/DCCTurnoutManager/Kconfig.projbuild
```kconfig
menu "DCC Turnout Manager"

    config TURNOUT_PERSISTENCE_INTERVAL_SEC
        int "Number of seconds between automatic persistence of turnout list"
        default 30

    choice TURNOUT_LOGGING
        bool "DNS logging"
        default TURNOUT_LOGGING_MINIMAL
        config TURNOUT_LOGGING_VERBOSE
            bool "Verbose"
        config TURNOUT_LOGGING_MINIMAL
            bool "Minimal"
    endchoice
    config TURNOUT_LOG_LEVEL
        int
        default 4 if TURNOUT_LOGGING_MINIMAL
        default 3 if TURNOUT_LOGGING_VERBOSE
        default 5
endmenu
```

## components/GPIO/Kconfig.projbuild
```kconfig
menu "GPIO"

    config GPIO_OUTPUTS
        bool "Enable GPIO pins to be used as outputs"
        default y
        help
            Enabling this option will allow usage of any free GPIO pin to be
            used as a controlled output.

    config GPIO_SENSORS
        bool "Enable GPIO pins to be used as sensors"
        default y
        help
            Enabling this option will allow usage of any free GPIO pin to be
            used as a polled input.

    config GPIO_S88
        bool "Enable S88 Sensor functionality"
        default n
        depends on GPIO_SENSORS
        help
            S88 (S88-n) is a feedback bus used primarily for occupancy
            detection but can be used for any digital input purposes. This
            module follows the S88-n timing as documented on http://www.s88-n.eu/

    menu "Remote Sensors"
        depends on GPIO_SENSORS

        config REMOTE_SENSORS_DECAY
            int "Number of milliseconds until a remote sensor will automatically clear"
            default 60000
            help
                If a remote sensor does not report it's state within this
                number of milliseconds it will automatically be deactivated.

        config REMOTE_SENSORS_FIRST_SENSOR
            int "First ID to assign remote sensors"
            default 100
            help
                All sensors must have a unique ID number assigned to them, this
                value allows configuring what the first sensor ID will be for
                any remote sensors that report to the command station.
    endmenu

    menu "S88 Sensors"
        depends on GPIO_S88

        config GPIO_S88_CLOCK_PIN
            int "S88 Clock pin"
            range 0 32
            default 17

        config GPIO_S88_RESET_PIN
            int "S88 Reset pin"
            range 0 32
            default 16

        config GPIO_S88_LOAD_PIN
            int "S88 Load pin"
            range 0 32
            default 27

        config GPIO_S88_FIRST_SENSOR
            int "First sensor ID"
            range 0 512
            default 512
            help
                This will be used for the first sensor bus and subsequent buses
                will start at the next sequential block of IDs. The block size
                is defined by the sensors per bus count below.

        config GPIO_S88_SENSORS_PER_BUS
            int "Maximum number of sensors per bus"
            range 8 512
            default 512
            help
                This is the maximum number of inputs that are supported per
                bus. In most cases the default of 512 is sufficient but if
                you have smaller buses and want to have sensor IDs more
                closely indexed this value can be adjusted to a lower value.
    endmenu

    config ALLOW_USAGE_OF_RESTRICTED_GPIO_PINS
        bool "Allow usage of restricted GPIO pins"
        default n
        depends on GPIO_OUTPUTS || GPIO_SENSORS || GPIO_S88
        help
            Enables usage of the following pins for sensors and outputs
            0 - Bootstrap / Firmware Flash Download
            1 - UART0 TX
            2 - Bootstrap / Firmware Flash Download
            3 - UART0 RX
            5 - Bootstrap
            6, 7, 8, 9, 10, 11 - flash pins
            12, 15 - Bootstrap / SD pins

endmenu
```

## components/GPIOOutputs/Kconfig.projbuild
```kconfig
menu "GPIO Outputs"

    config ENABLE_OUTPUTS
        bool "Enable GPIO pins to be used as outputs"
        default y

endmenu
```

## components/GPIOSensors/Kconfig.projbuild
```kconfig
menu "GPIO Sensors"

    config ENABLE_SENSORS
        bool "Enable GPIO pins to be used as sensors"
        default y

    menu "Remote Sensors"
        depends on ENABLE_SENSORS

        config REMOTE_SENSORS_DECAY
            int "Number of milliseconds until a remote sensor will automatically clear"
            default 60000
        config REMOTE_SENSORS_FIRST_SENSOR
            int "First ID to assign remote sensors"
            default 100
    endmenu

    menu "S88 Sensors"
        depends on ENABLE_SENSORS

        config S88
            bool "Enable S88 Sensor functionality"
            default n

        config S88_CLOCK_PIN
            int "S88 Clock pin"
            range 0 32
            depends on S88

        config S88_RESET_PIN
            int "S88 Reset pin"
            range 0 32
            depends on S88

        config S88_LOAD_PIN
            int "S88 Load pin"
            range 0 32
            depends on S88

        config S88_FIRST_SENSOR
            int "First sensor ID"
            default 255

        config S88_MAX_SENSORS_PER_BUS
            int
            default 255
    endmenu

endmenu
```

## components/JmriInterface/Kconfig.projbuild
```kconfig
menu "JMRI Interface"
    config JMRI
        bool "Enable JMRI listener"
        default y
    config JMRI_LISTENER_PORT
        int "JMRI Listener port"
        default 2560
    config JMRI_MDNS_SERVICE_NAME
        string "mDNS service name to advertise"
        default "_esp32cs._tcp"
endmenu
```

## main/Kconfig.projbuild
```kconfig
menu "WiFi Configuration"
    config HOSTNAME_PREFIX
        string "Hostname prefix"
        default "esp32cs_"
        help
            The LCC node id will be appended to this value, ie: esp32cs_050101013F00.

    choice WIFI_MODE
        bool "WiFi mode"
        default WIFI_MODE_SOFTAP
        config WIFI_MODE_STATION
            bool "Connect to SSID"
        config WIFI_MODE_SOFTAP
            bool "Create SoftAP"
        config WIFI_MODE_SOFTAP_STATION
            bool "Connect to SSID and create SoftAP"
    endchoice

    config WIFI_SOFTAP_SSID
        string "SoftAP SSID"
        depends on WIFI_MODE_SOFTAP

    config WIFI_SSID
        string "SSID"
        depends on WIFI_MODE_STATION || WIFI_MODE_SOFTAP_STATION

    config WIFI_PASSWORD
        string "Password"
        depends on WIFI_MODE_STATION || WIFI_MODE_SOFTAP_STATION

    choice WIFI_IP_TYPE
        bool "WiFi IP"
        default WIFI_IP_DHCP
        config WIFI_IP_DHCP
            bool "DHCP"
        config WIFI_IP_STATIC
            bool "Static"
    endchoice

    config WIFI_STATIC_IP_ADDRESS
        string "IP address"
        default "10.0.0.155"
        depends on WIFI_IP_STATIC

    config WIFI_STATIC_IP_GATEWAY
        string "Gateway IP address"
        default "10.0.0.1"
        depends on WIFI_IP_STATIC

    config WIFI_STATIC_IP_SUBNET
        string "Subnet mask"
        default "255.255.255.0"
        depends on WIFI_IP_STATIC

    config WIFI_STATIC_IP_DNS
        string "Primary DNS address"
        default "8.8.8.8"
        depends on WIFI_IP_STATIC

    config WIFI_SOFT_AP_CHANNEL
        int
        default 6
endmenu

menu "LCC Configuration"
    config LCC_NODE_ID
        hex "Node ID"
        default 0x050101013F00
        help 
            This is the LCC node identifier for the ESP32 Command Station.
            It is recommended, but not required, to request your own ID
            range via:
            https://registry.openlcb.org/requestuniqueidrange

    config LCC_CAN_ENABLED
        bool "CAN interface"
        default n
        help
            Enabling this option will require an externally connected
            SN6565HVD23x or MCP2551 IC.

    config LCC_CAN_RX_PIN
        int "CAN RX Pin"
        range 0 39
        depends on LCC_CAN_ENABLED
        help
            This is the ESP32 pin connected to the SN6565HVD23x/MCP2551 R (RX) pin.

    config LCC_CAN_TX_PIN
        int "CAN TX Pin"
        range 0 32
        depends on LCC_CAN_ENABLED
        help
            This is the ESP32 pin connected to the SN6565HVD23x/MCP2551 D (TX) pin.

    config LCC_FACTORY_RESET
        bool "Perform LCC Factory reset on startup"
        default n
        help
            Enabling this option will force the removal of the cached CDI
            and node configuration files on every startup of the node. This
            is generally not required or recommended.

    config LCC_MEMORY_SPACES
        int "MemoryConfig space limit"
        default 10
        help
            Maximum number of memory spaces that can be registered for the
            MemoryConfig datagram handler.

    config LCC_PRINT_ALL_PACKETS
        bool "Print all packets"
        default n
        help
            Enabling this option will cause all LCC packets to be printed to
            the serial console.

    config LCC_EXECUTOR_SELECT_PRESCALER
        int "StateFlows to execute between select() calls"
        range 5 300
        default 60
        help
            Executors will run this many Executables (if there is anything
            scheduled) before two calls to select. This helps in reducing the
            overhead of the select calls.

    config LCC_LOCAL_NODE_COUNT
        int "Number of 'local' LCC nodes"
        default 30
        help
            This controls how many trains will be supported concurrently by
            the command station.

    config LCC_SD_FSYNC_SEC
        int "Automatic fsync() interval (seconds)"
        default 10
        help
            For some file systems (SD only currently) it is required to call
            fsync() to force synchronize file changes to the file system due to
            small file size. In the case of the SD file system any file
            modification smaller than 512 bytes will remain in the in-memory
            cache and not be persisted to the SD card without a call to fsync()
            or close(). In the case of the LCC CDI file, the CDI file remains
            open for the lifetime of the application.

    config LCC_GC_NEWLINES
        bool "Add newline to GridConnect packets"
        default n
        help
            Enabling this option will generate a newline character after
            every GridConnect packet that is sent out. This is generally
            only needed for debug purposes.

    config LCC_GC_DELAY_USEC
        int "GridConnect packet delay (microseconds)"
        default 500
        help
            How long (in microseconds) to buffer generated gridconnect data
            before sending off to the lowlevel system (such as a TCP socket).

    config LCC_GC_OUTBOUND_PACKET_LIMIT
        int "GridConnect packet count limit"
        default 2
        help
            Number of pending buffers (of type string) in the outgoing hub on a
            per-connection basis. This limit ensures that we don't leak memory
            if the output socket cannot send the data fast enough.

    config ESP32CS_CDI_VERSION
        hex
        default 0x0150
endmenu

menu "Nextion HMI Configuration"
    config NEXTION
        bool "Enable Nextion HMI interface"
        default n
        help
            The Nextion HMI interface provides a throttle interface
            directly connected to the ESP32 Command Station.

    config NEXTION_RX_PIN
        int "RX Pin"
        range 0 39
        help
            This should be connected to the TX pin on the Nextion HMI,
            typically the blue wire.
        depends on NEXTION

    config NEXTION_TX_PIN
        int "TX Pin"
        range 0 32
        help
            This should be connected to the RX pin on the Nextion HMI,
            typically the yellow wire.
        depends on NEXTION

    config NEXTION_BAUD_RATE
        int "BAUD rate"
        default 115200
        help
            This must match the "bauds=XXX" value set in the Nextion
            HMI initialization event.
        depends on NEXTION

    choice NEXTION_UART
        bool "Hardware UART to use for the Nextion HMI"
        default NEXTION_UART_UART1
        depends on NEXTION
        config NEXTION_UART_UART1
            bool "UART1"
            depends on !OPS_RAILCOM_UART1 && !HC12_UART_UART1
        config NEXTION_UART_UART2
            bool "UART2"
            depends on !OPS_RAILCOM_UART2 && !HC12_UART_UART2
    endchoice

    config NEXTION_UART
        int
        default 1 if NEXTION_UART_UART1
        default 2 if NEXTION_UART_UART2
        depends on NEXTION
endmenu

# LocoNet will not be supported in v1.5.0 so it must remain disabled.
if 0
menu "LocoNet"
    config LOCONET
        bool "Enable LocoNet interface"
        default n
        help
            The LocoNet interface allows using many of the available
            LocoNet sensors, throttles, accessories, etc with the ESP32
            Command Station. It is still under active development, if you
            find a device that does not work please let us know.

    config LOCONET_RX_PIN
        int "Pin connected to the LocoNet RX pin"
        range 0 39
        depends on LOCONET

    config LOCONET_TX_PIN
        int "Pin connected to the LocoNet TX pin"
        range 0 32
        depends on LOCONET
        
    choice LOCONET_UART
        bool "Hardware UART to use for LocoNet"
        default HC12_UART_UART1
        depends on LOCONET
        config LOCONET_UART_UART1
            bool "UART1"
            depends on !OPS_RAILCOM_UART1 && !HC12_UART_UART1 && !NEXTION_UART_UART1
        config LOCONET_UART_UART2
            bool "UART2"
            depends on !OPS_RAILCOM_UART2 && !HC12_UART_UART2 && !NEXTION_UART_UART2
    endchoice

    config LOCONET_INVERTED_LOGIC
        bool "Use inverted logic"
        default y
        help
            If you are using the LM311 circuit as defined on the ESP32
            Command Station website it is necessary to invert the logic.
            If you are using a different circuit you might be able to
            disable this option.
            
    config LOCONET_RX_PULLUP
        bool "Use pull-up resistor on RX pin"
        default y
        help
            If you are using the LM311 circuit as defined in the ESP32
            Command Station website and do not have a resistor connected
            between 3v3 (VCC) and the LOCONET_RX_PIN it is necessary to
            enable the internal pull up for the RX pin to ensure proper
            logic. If you have an external pull-up resistor this option can
            be disabled.
endmenu
endif
```
